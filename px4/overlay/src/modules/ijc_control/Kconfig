## px4/overlay/src/modules/ijc_control/Kconfig
```kconfig
menuconfig MODULES_IJC_CONTROL
	bool "ijc_control"
	default n
	---help---
		Enable support for ijc_control (observer-based tail-sitter controller)
```
